## sdkconfig.defaults
```kconfig
CONFIG_PARTITION_TABLE_CUSTOM=y
CONFIG_PARTITION_TABLE_CUSTOM_FILENAME="partitions.csv"
CONFIG_PARTITION_TABLE_FILENAME="partitions.csv"

# Flash size & Mode - 16MB QIO for ESP32-P4
CONFIG_ESPTOOLPY_FLASHSIZE_16MB=y
CONFIG_ESPTOOLPY_FLASHSIZE="16MB"
CONFIG_ESPTOOLPY_FLASHMODE_QIO=y
CONFIG_ESPTOOLPY_FLASHFREQ_80M=y

# PSRAM / SPIRAM Settings - 200MHz HEX mode
CONFIG_SPIRAM=y
CONFIG_SPIRAM_MODE_HEX=y
CONFIG_SPIRAM_SPEED_200M=y
CONFIG_SPIRAM_BOOT_INIT=y
CONFIG_SPIRAM_USE_MALLOC=y
CONFIG_SPIRAM_MEMTEST=n
CONFIG_SPIRAM_ECC_ENABLE=n

# Hardware Settings for ESP32-P4
CONFIG_IDF_EXPERIMENTAL_FEATURES=y
CONFIG_ESP_DEFAULT_CPU_FREQ_MHZ_360=y
CONFIG_ESP_DEFAULT_CPU_FREQ_MHZ=360

# Display Settings
CONFIG_BSP_LCD_TYPE_720_1280_7_INCH_A=y

# LVGL Color Depth - 16-bit (matches display stable mode)
CONFIG_LV_COLOR_DEPTH_16=y
CONFIG_LV_DPI_DEF=130

# LVGL Buffer Alignment - RE-ENABLED for 64-byte hardware stride
CONFIG_LV_DRAW_BUF_ALIGN=64
CONFIG_LV_DRAW_BUF_STRIDE_ALIGN=64
CONFIG_LV_ATTRIBUTE_MEM_ALIGN_SIZE=64

# LVGL Fonts - Montserrat (4 BPP) + UNSCII (1 BPP for performance)
CONFIG_LV_FONT_MONTSERRAT_10=y
CONFIG_LV_FONT_MONTSERRAT_12=y
CONFIG_LV_FONT_MONTSERRAT_14=y
CONFIG_LV_FONT_MONTSERRAT_20=y
CONFIG_LV_FONT_MONTSERRAT_24=y
CONFIG_LV_FONT_MONTSERRAT_32=y
CONFIG_LV_FONT_MONTSERRAT_48=y
CONFIG_LV_FONT_UNSCII_8=y
CONFIG_LV_FONT_UNSCII_16=y

# HTTP & Web
CONFIG_HTTPD_WS_SUPPORT=y

# Task Watchdog - LVGL uses most of Core 1, so we can't monitor IDLE tasks
CONFIG_ESP_TASK_WDT_TIMEOUT_S=60
CONFIG_ESP_TASK_WDT_PANIC=n
CONFIG_ESP_TASK_WDT_CHECK_IDLE_TASK_CPU0=n
CONFIG_ESP_TASK_WDT_CHECK_IDLE_TASK_CPU1=n

# Rendering Quality
CONFIG_LV_DRAW_SW_COMPLEX=y
CONFIG_LV_USE_PPA=n

# FreeRTOS Run-Time Stats (CPU Load Monitoring)
CONFIG_FREERTOS_GENERATE_RUN_TIME_STATS=y
CONFIG_FREERTOS_USE_TRACE_FACILITY=y
CONFIG_FREERTOS_USE_STATS_FORMATTING_FUNCTIONS=y
CONFIG_FREERTOS_VTASKLIST_INCLUDE_COREID=y
CONFIG_ESP_HOSTED_SDIO_HOST_INTERFACE=y
CONFIG_ESP_HOSTED_SDIO_RESET_ACTIVE_HIGH=y
CONFIG_ESP_HOSTED_SDIO_OPTIMIZATION_RX_STREAMING_MODE=y
CONFIG_ESP_HOSTED_SDIO_SLOT_1=y
CONFIG_ESP_HOSTED_SDIO_SLOT=1
CONFIG_ESP_HOSTED_SDIO_4_BIT_BUS=y
CONFIG_ESP_HOSTED_SDIO_BUS_WIDTH=4
CONFIG_ESP_HOSTED_SDIO_CLOCK_FREQ_KHZ=40000
CONFIG_ESP_HOSTED_SDIO_GPIO_RESET_SLAVE=54
CONFIG_ESP_HOSTED_SDIO_PIN_CMD=19
CONFIG_ESP_HOSTED_SDIO_PIN_CLK=18
CONFIG_ESP_HOSTED_SDIO_PIN_D0=14
CONFIG_ESP_HOSTED_SDIO_PIN_D1=15
CONFIG_ESP_HOSTED_SDIO_PIN_D2=16
CONFIG_ESP_HOSTED_SDIO_PIN_D3=17

# FATFS Long File Name Support
CONFIG_FATFS_LFN_HEAP=y
CONFIG_FATFS_MAX_LFN=255

# MbedTLS PSRAM and Memory Optimizations
CONFIG_MBEDTLS_INTERNAL_MEM_ALLOC=n
CONFIG_MBEDTLS_EXTERNAL_MEM_ALLOC=y
CONFIG_MBEDTLS_DYNAMIC_BUFFER=y


# App Claw Capabilities Overrides (Disabled)
CONFIG_APP_CLAW_CAP_IM_QQ=n
CONFIG_APP_CLAW_CAP_IM_FEISHU=n
CONFIG_APP_CLAW_CAP_IM_WECHAT=n
CONFIG_APP_CLAW_CAP_MCP_CLIENT=n
CONFIG_APP_CLAW_CAP_MCP_SERVER=n

# App Claw Lua Modules Overrides (Disabled)
CONFIG_APP_CLAW_LUA_MODULE_IMU=n
CONFIG_APP_CLAW_LUA_MODULE_BQ27220=n
CONFIG_APP_CLAW_LUA_MODULE_TOUCH=n
CONFIG_APP_CLAW_LUA_MODULE_ADC=n
CONFIG_APP_CLAW_LUA_MODULE_BOARD_MANAGER=n
CONFIG_APP_CLAW_LUA_MODULE_CAPABILITY=n
CONFIG_APP_CLAW_LUA_MODULE_BUTTON=n
CONFIG_APP_CLAW_LUA_MODULE_DELAY=n
CONFIG_APP_CLAW_LUA_MODULE_DISPLAY=n
CONFIG_APP_CLAW_LUA_MODULE_ESP_HEAP=n
CONFIG_APP_CLAW_LUA_MODULE_EVENT_PUBLISHER=n
CONFIG_APP_CLAW_LUA_MODULE_GPIO=n
CONFIG_APP_CLAW_LUA_MODULE_I2C=n
CONFIG_APP_CLAW_LUA_MODULE_LED_STRIP=n
CONFIG_APP_CLAW_LUA_MODULE_MCPWM=n
CONFIG_APP_CLAW_LUA_MODULE_STORAGE=n
CONFIG_APP_CLAW_LUA_MODULE_SYSTEM=n
CONFIG_APP_CLAW_LUA_MODULE_UART=n
CONFIG_APP_CLAW_LUA_MODULE_AUDIO=n
CONFIG_APP_CLAW_LUA_MODULE_CAMERA=n

CONFIG_ESP_MAIN_TASK_STACK_SIZE=8192
# CONFIG_LV_MEM_SIZE_KILOBYTES is not set
CONFIG_LV_MEM_CUSTOM=y
```
